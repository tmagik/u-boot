## arch/riscv/cpu/fu540/Kconfig
```kconfig
config SIFIVE_DENALI
	bool "SiFive Denali DTB memory init"
	help
	  Enable the SiFive Denali memory init code

config LEGACY_MEMORY_INIT
	bool "SiFive FU540 legacy memory init"
	help
	  Legacy header file based memory init code
```

## configs/sifive_fu540_defconfig
```kconfig
CONFIG_RISCV=y
CONFIG_TARGET_SIFIVE_FU540=y
CONFIG_RISCV_SMODE=y
CONFIG_ARCH_RV64I=y
CONFIG_DISTRO_DEFAULTS=y
CONFIG_NR_DRAM_BANKS=1
CONFIG_FIT=y
CONFIG_DISPLAY_CPUINFO=y
CONFIG_DISPLAY_BOARDINFO=y
CONFIG_CMD_MII=y
CONFIG_OF_PRIOR_STAGE=y

# dram init version
CONFIG_MISC
CONFIG_EMEMORY_OTP=y
CONFIG_MISC_INIT_R=y
```

## configs/sifive_fu540_fsbl_defconfig
```kconfig
CONFIG_RISCV=y
CONFIG_SYS_TEXT_BASE=0x08000000
CONFIG_NR_DRAM_BANKS=1
CONFIG_TARGET_SIFIVE_FU540=y
CONFIG_SIFIVE_DENALI=y
CONFIG_SIFIVE_LEGACY_MEMORY_INIT=y
CONFIG_ARCH_RV64I=y
CONFIG_DISTRO_DEFAULTS=y
CONFIG_FIT=y
CONFIG_MISC_INIT_R=y
CONFIG_DISPLAY_CPUINFO=y
CONFIG_DISPLAY_BOARDINFO=y
CONFIG_CMD_CLK=y
CONFIG_CMD_SF=y
CONFIG_CMD_SF_TEST=y
CONFIG_CMD_SPI=y
CONFIG_DEFAULT_SPI_MODE=0x0
CONFIG_OF_EMBED=y
CONFIG_DEFAULT_DEVICE_TREE="hifive-unleashed-a00"
CONFIG_CACHE=y
CONFIG_MISC=y
CONFIG_EMEMORY_OTP=y
CONFIG_RAM=y
# CONFIG_SPECIFY_CONSOLE_INDEX is not set
# CONFIG_DM_SERIAL is not set
CONFIG_HIFIVE_SERIAL=y
```
